## base_external/package/aesdchar/Config.in
```kconfig
config BR2_PACKAGE_AESDCHAR
	bool "aesdchar-package"
	help
	  This package builds the aesdchar components
	  from assignment 3 into the root filesystem.
```

## base_external/package/ldd/Config.in
```kconfig
config BR2_PACKAGE_LDD
	bool "ldd package"
	help
	  This package builds the misc-modules and scull components
	  from assignment 7 into the root filesystem.
```
